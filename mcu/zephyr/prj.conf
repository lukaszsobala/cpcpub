## CMakeLists.txt
```
# cpcpub for any board the Zephyr RTOS supports, as a Zephyr application.
#
#   west build -b nrf52840dk/nrf52840 mcu/zephyr
#   west flash
#
# See mcu/README.md.

cmake_minimum_required(VERSION 3.20.0)
find_package(Zephyr REQUIRED HINTS $ENV{ZEPHYR_BASE})
project(cpcpub C)

# What --version reports; `west build ... -- -DCPCPUB_VERSION=v1.2` sets it.
if(NOT CPCPUB_VERSION)
    set(CPCPUB_VERSION "dev")
endif()

set(BENCH_SRC ${CMAKE_CURRENT_LIST_DIR}/../../bench/src)
set(MCU_SRC   ${CMAKE_CURRENT_LIST_DIR}/..)

# The flags bench/Makefile builds the desktop binary with, for this
# repository's sources only; Zephyr's own keep Zephyr's. gnu2x where the
# desktop has c2x, as in the other microcontroller builds: the same dialect,
# and the kernels use no extension.
set(CPCPUB_CFLAGS -O3 -std=gnu2x -Wall -Wextra -Wshadow -Wconversion
                  -Wdouble-promotion -Wformat=2 -fno-strict-aliasing)

# The four compilations, as in bench/Makefile: one source compiled once per
# variant, so each is a one-line file including kernels.c with that variant's
# flags.
set(VARIANTS scalar-nofma vector-nofma scalar-fma vector-fma)
set(KV_FLAGS_scalar-nofma -fno-tree-vectorize -ffp-contract=off)
set(KV_FLAGS_vector-nofma -ftree-vectorize -ffp-contract=off)
set(KV_FLAGS_scalar-fma   -fno-tree-vectorize -ffp-contract=fast)
set(KV_FLAGS_vector-fma   -ftree-vectorize -ffp-contract=fast)
set(KV_VEC_scalar-nofma 0)
set(KV_VEC_vector-nofma 1)
set(KV_VEC_scalar-fma   0)
set(KV_VEC_vector-fma   1)
set(KV_FMA_scalar-nofma 0)
set(KV_FMA_vector-nofma 0)
set(KV_FMA_scalar-fma   1)
set(KV_FMA_vector-fma   1)

set(CPCPUB_SOURCES ${BENCH_SRC}/measure.c ${BENCH_SRC}/report.c
                   ${MCU_SRC}/frontend.c ${CMAKE_CURRENT_LIST_DIR}/src/port.c)
target_sources(app PRIVATE ${CPCPUB_SOURCES})
target_include_directories(app PRIVATE ${BENCH_SRC} ${MCU_SRC})
target_compile_definitions(app PRIVATE CPCPUB_ZEPHYR=1)

# Reported in build.flags with the architecture's own (-mcpu, -mfpu, -march)
# that Zephyr picked for the board, so a result says what it was built with.
# A --sysroot into the toolchain's install is cut to its last part: where
# someone unpacked the SDK says nothing about the build.
string(JOIN " " BUILD_FLAGS ${TOOLCHAIN_C_FLAGS} ${CPCPUB_CFLAGS})
string(REGEX REPLACE "--sysroot=[^ ]*/" "--sysroot=" BUILD_FLAGS "${BUILD_FLAGS}")
get_filename_component(BUILD_CC "${CMAKE_C_COMPILER}" NAME)
set_source_files_properties(${CPCPUB_SOURCES} PROPERTIES
    COMPILE_OPTIONS "${CPCPUB_CFLAGS}"
    COMPILE_DEFINITIONS "CPCPUB_VERSION=\"${CPCPUB_VERSION}\";BUILD_CC=\"${BUILD_CC}\";BUILD_FLAGS=\"${BUILD_FLAGS}\"")

foreach(v ${VARIANTS})
    string(REPLACE "-" "_" id ${v})
    string(JOIN " " flags ${KV_FLAGS_${v}})
    set(f ${CMAKE_CURRENT_BINARY_DIR}/kernels-${v}.c)
    file(WRITE ${f}.tmp "#include \"kernels.c\"\n")
    configure_file(${f}.tmp ${f} COPYONLY)
    target_sources(app PRIVATE ${f})
    set_source_files_properties(${f} PROPERTIES
        COMPILE_OPTIONS "${CPCPUB_CFLAGS};${KV_FLAGS_${v}}"
        COMPILE_DEFINITIONS "KV_ID=_${id};KV_NAME=\"${v}\";KV_FLAGS=\"${flags}\";KV_VECTORIZE=${KV_VEC_${v}};KV_FMA=${KV_FMA_${v}}")
endforeach()
```

## Kconfig
```
# What the benchmark asks of the kernel configuration, wherever the board has
# it to give. `imply` rather than prj.conf lines, so a board without, say, an
# FPU or a second CPU builds without a warning about an option it cannot take.

mainmenu "cpcpub"

source "Kconfig.zephyr"

config CPCPUB
	bool
	default y
	# The FPU where there is one, with its registers saved per thread: the
	# workers and the console all use floating point.
	imply FPU
	imply FPU_SHARING
	# Pinning each worker to its CPU on an SMP board.
	imply SCHED_CPU_MASK
	# A 64-bit cycle count from the Cortex-M SysTick, for the clock.
	imply CORTEX_M_SYSTICK_64BIT_CYCLE_COUNTER
	# printf that formats %g and %llu, as the tables and the document need,
	# from whichever C library the board builds with.
	select REQUIRES_FLOAT_PRINTF
```

## prj.conf
```kconfig
# The console: read a line, print the tables and the document.
CONFIG_CONSOLE_SUBSYS=y
CONFIG_CONSOLE_GETCHAR=y

# The front end runs in the main thread, with its large arrays static rather
# than on this stack.
CONFIG_MAIN_STACK_SIZE=8192

# Zephyr's own code optimised for speed rather than size; this repository's
# sources get -O3 from CMakeLists.txt either way.
CONFIG_SPEED_OPTIMIZATIONS=y
```

## boards/qemu_cortex_a53_qemu_cortex_a53_smp.conf
```kconfig
# QEMU's two-CPU Cortex-A53, used to test the multi-CPU path -- the barrier and
# the pinning -- where there is no board to hand. An MMU build gets a 16 KiB
# malloc arena by default; the memory phases want more.
CONFIG_COMMON_LIBC_MALLOC_ARENA_SIZE=4194304
```

## src/port.c
```c
// The Zephyr RTOS, on any board it supports: see mcu/port.h.
//
// Each run starts one thread per worker, pinned to its CPU before it starts on
// an SMP build, and joins them all; the stacks are static, so the heap the
// memory phases measure is not shared with them. The console is Zephyr's own
// -- the board's chosen UART, or USB CDC where the board says so.
//
// Nothing portable measures a core's clock here, so the result carries the
// rated one: the device tree's, or else the SysTick rate on a Cortex-M whose
// SysTick counts the processor clock -- which is Zephyr's configuration unless
// the tree says otherwise.

#include <stdint.h>
#include <stdio.h>
#include <string.h>

// Zephyr's headers, with the conversion warnings off for them alone: see
// bench/src/platform_zephyr.h.
#pragma GCC diagnostic push
#pragma GCC diagnostic ignored "-Wconversion"
#pragma GCC diagnostic ignored "-Wsign-conversion"
#include <zephyr/kernel.h>
#include <zephyr/console/console.h>
#include <zephyr/devicetree.h>
#include <zephyr/version.h>
#pragma GCC diagnostic pop

#include "port.h"

int main(void) {
    frontend_run();
    return 0;
}

void port_init(void) {
    console_init();
}

int port_getchar(void) {
    int c;
    while ((c = console_getchar()) < 0) {}
    return c;
}

// ---------------------------------------------------------------------------
// The worker threads
// ---------------------------------------------------------------------------

// Cooperative, so nothing preemptible -- the console thread among them -- can
// take the CPU from a worker; it gives it up only to wait at a barrier.
#define WORKER_PRIO  K_PRIO_COOP(CONFIG_NUM_COOP_PRIORITIES - 1)
#define WORKER_STACK 8192

K_THREAD_STACK_ARRAY_DEFINE(g_stack, CONFIG_MP_MAX_NUM_CPUS, WORKER_STACK);
static struct k_thread g_thread[CONFIG_MP_MAX_NUM_CPUS];

static void worker_entry(void *w, void *unused1, void *unused2) {
    (void)unused1;
    (void)unused2;
    worker(w);
}

void port_run(worker_t *w, const int *cores, int n) {
    for (int i = 0; i < n; ++i) {
        k_thread_create(&g_thread[i], g_stack[i], K_THREAD_STACK_SIZEOF(g_stack[i]),
                        worker_entry, &w[i], NULL, NULL, WORKER_PRIO, K_FP_REGS,
                        K_FOREVER);
#if defined(CONFIG_SCHED_CPU_MASK)
        (void)k_thread_cpu_pin(&g_thread[i], cores[i]);
#else
        (void)cores;
#endif
    }
    for (int i = 0; i < n; ++i) k_thread_start(&g_thread[i]);
    for (int i = 0; i < n; ++i) (void)k_thread_join(&g_thread[i], K_FOREVER);
}

// ---------------------------------------------------------------------------
// Memory
// ---------------------------------------------------------------------------

size_t port_heap_bytes(void) {
#if defined(CONFIG_SRAM_SIZE)
    return heap_probe((size_t)CONFIG_SRAM_SIZE * 1024u);
#else
    return heap_probe((size_t)64 << 20);
#endif
}

// ---------------------------------------------------------------------------
// Clocks
// ---------------------------------------------------------------------------

#define CPU0 DT_PATH(cpus, cpu_0)

double cpu_cur_mhz(int cpu) {
    (void)cpu;
    return 0.0;
}

double rated_mhz(int cpu) {
    (void)cpu;
#if DT_NODE_HAS_PROP(CPU0, clock_frequency)
    return (double)DT_PROP(CPU0, clock_frequency) / 1e6;
#elif defined(CONFIG_CORTEX_M_SYSTICK) && \
      !DT_PROP_OR(DT_NODELABEL(systick), external_clock_source, 0)
    return (double)sys_clock_hw_cycles_per_sec() / 1e6;
#else
    return 0.0;
#endif
}

// No DRAM to speak of on the boards this is for, and nothing to read it from.
double dram_mhz(void) { return 0.0; }

// ---------------------------------------------------------------------------
// The machine
// ---------------------------------------------------------------------------

// "arm,cortex-m4f" -> "Cortex-M4F": the core as its maker writes it, from the
// device tree's own compatible string.
static const char *core_name(void) {
    static char out[48];
#if DT_NODE_EXISTS(CPU0) && DT_NODE_HAS_PROP(CPU0, compatible)
    const char *c = DT_PROP_BY_IDX(CPU0, compatible, 0);
    const char *comma = strchr(c, ',');
    if (comma) c = comma + 1;
    // RISC-V cores are named after the ISA, then the variant: "riscv-virt"
    // reads as "RISC-V virt".
    if (!strncmp(c, "riscv", 5)) {
        snprintf(out, sizeof(out), "RISC-V%s%s", c[5] ? " " : "", c[5] ? c + 6 : "");
        return out;
    }
    // The first letter, and everything after the first hyphen, in capitals.
    size_t n = 0;
    for (int up = 1, after = 0; *c && n + 1 < sizeof(out); ++c) {
        out[n++] = (up || after) && *c >= 'a' && *c <= 'z' ? (char)(*c - 'a' + 'A') : *c;
        up = 0;
        after = after || *c == '-';
    }
    out[n] = '\0';
#else
    snprintf(out, sizeof(out), "%s", CONFIG_ARCH);
#endif
    return out;
}

// None. A Zephyr build is per board and no release publishes one, so a digest
// would match nothing; where the image ends in flash also differs with the
// board's memory layout.
int port_image_sha256(char out_hex[65]) {
    out_hex[0] = '\0';
    return -1;
}

void port_info(port_info_t *out) {
    out->chip = CONFIG_SOC;
    out->core = core_name();
#if defined(CONFIG_ARM64)
    out->target = "aarch64";
#elif defined(CONFIG_ARMV8_M_MAINLINE) || defined(CONFIG_ARMV8_M_BASELINE)
    out->target = "armv8m";
#elif defined(CONFIG_ARMV7_M_ARMV8_M_MAINLINE)
    out->target = "armv7m";
#elif defined(CONFIG_ARMV6_M_ARMV8_M_BASELINE)
    out->target = "armv6m";
#elif defined(CONFIG_RISCV) && defined(CONFIG_64BIT)
    out->target = "riscv64";
#elif defined(CONFIG_RISCV)
    out->target = "riscv32";
#elif defined(CONFIG_XTENSA)
    out->target = "xtensa";
#elif defined(CONFIG_ARCH_POSIX) && defined(__x86_64__)
    out->target = "x86_64";
#elif defined(CONFIG_ARCH_POSIX) && defined(__aarch64__)
    out->target = "aarch64";
#elif defined(CONFIG_X86_64)
    out->target = "x86_64";
#else
    out->target = CONFIG_ARCH;
#endif
    out->sdk = "zephyr";
    out->sdk_ver = KERNEL_VERSION_STRING;
}
```
